## drivers/net/wireless/rockchip_wlan/mvl88w8987/Kconfig
```kconfig
# SPDX-License-Identifier: GPL-2.0
config MVL88W8987
        tristate "AW 88W8987 SDIO WiFi"
        help
          Help message of MVL88W8987
```
